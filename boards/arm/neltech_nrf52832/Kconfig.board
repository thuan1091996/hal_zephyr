## boards/arm/neltech_nrf52832/Kconfig.board
```kconfig
# Copyright (c) 2024 Nordic Semiconductor ASA
# SPDX-License-Identifier: Apache-2.0

config BOARD_NELTECH_NRF52832
	bool "Neltech nRF52832"
	depends on SOC_NRF52832_QFAA
```

## boards/arm/neltech_nrf52832/Kconfig.defconfig
```kconfig
# Copyright (c) 2024 Nordic Semiconductor ASA
# SPDX-License-Identifier: Apache-2.0

if BOARD_NELTECH_NRF52832

config BOARD
	default "neltech_nrf52832"

config BT_CTLR
   default BT
   


endif
```

## boards/arm/neltek_nrf52832/Kconfig.board
```kconfig
# Copyright (c) 2024 Nordic Semiconductor ASA
# SPDX-License-Identifier: Apache-2.0

config BOARD_NELTEK_NRF52832
	bool "Neltek nRF52832"
	depends on SOC_NRF52832_QFAA
```

## boards/arm/neltek_nrf52832/Kconfig.defconfig
```kconfig
# Copyright (c) 2024 Nordic Semiconductor ASA
# SPDX-License-Identifier: Apache-2.0

if BOARD_NELTEK_NRF52832

config BOARD
	default "neltek_nrf52832"

config BT_CTLR
   default BT

config BOARD_ENABLE_DCDC
	bool "DCDC mode"
	select SOC_DCDC_NRF52X
	default y

config GPIO_PIN_NUM
	int "GPIO pin number"
	default 32
	help
	  Total number of GPIO pins available on the board.

config GPIO_PORT_PIN_NUM 
	int "GPIO pin per port"
	default 32
	help
	  Number of GPIO pins per port.

config GPIO_NRESET_PIN
	int "GPIO pin number for nRESET"
	default 21
	help
	  GPIO pin number for nRESET.
   
endif
```

## tests/unit_testing/gpio_hal/testcase.yaml
```yaml
tests:
  # section.subsection
  sample.testing.ztest:
    # build_only: true
    platform_allow: native_posix nrf52840dk_nrf52840
    integration_platforms:
      - native_posix
      - nrf52840dk_nrf52840
    tags:  drivers gpio
    depends_on: gpio
```
